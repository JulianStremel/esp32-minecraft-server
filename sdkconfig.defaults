## sdkconfig.defaults.esp32p4
```kconfig
CONFIG_ESP_DEFAULT_CPU_FREQ_MHZ_400=y
CONFIG_ETH_USE_ESP32_EMAC=y
CONFIG_ESP32P4_REV_MIN_300=y
```

## sdkconfig.defaults.esp32s3
```kconfig
CONFIG_ESP32S3_DEFAULT_CPU_FREQ_240=y
CONFIG_SPIRAM_MODE_OCT=y
CONFIG_SPIRAM_SPEED_80M=y
CONFIG_SPIRAM_TRY_ALLOCATE_WIFI_LWIP=y
```

## src/Kconfig.projbuild
```kconfig
menu "Minecraft network configuration"
    depends on IDF_TARGET_ESP32P4

# the defaults: Waveshare's ESP32-P4-ETH (and Espressif's P4 boards): an IP101 PHY at
# address 1, reset on GPIO 51, the 50 MHz reference clock from the board on GPIO 50
choice MC_ETH_PHY
    prompt "Ethernet PHY"
    default MC_ETH_PHY_IP101
config MC_ETH_PHY_IP101
    bool "IP101 (Waveshare ESP32-P4-ETH, Espressif P4 boards)"
config MC_ETH_PHY_LAN87XX
    bool "LAN8720 / LAN87xx"
endchoice
config MC_ETH_PHY_ADDR
    int "PHY address (-1 for auto-detect)"
    range -1 31
    default 1
config MC_ETH_PHY_RESET
    int "PHY reset GPIO (-1 for no reset line)"
    default 51
config MC_ETH_MDC
    int "RMII MDC GPIO"
    default 31
config MC_ETH_MDIO
    int "RMII MDIO GPIO"
    default 52
config MC_ETH_CLK_OUT
    bool "Output 50 MHz RMII clock (otherwise receive external clock)"
    default n
config MC_ETH_CLK_GPIO
    int "RMII clock GPIO"
    default 50
config MC_ETH_TX_EN
    int "RMII TX_EN GPIO"
    default 49
config MC_ETH_TXD0
    int "RMII TXD0 GPIO"
    default 34
config MC_ETH_TXD1
    int "RMII TXD1 GPIO"
    default 35
config MC_ETH_CRS_DV
    int "RMII CRS_DV GPIO"
    default 28
config MC_ETH_RXD0
    int "RMII RXD0 GPIO"
    default 29
config MC_ETH_RXD1
    int "RMII RXD1 GPIO"
    default 30
endmenu
```
